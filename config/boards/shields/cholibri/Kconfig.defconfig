## config/boards/shields/cholibri/Kconfig.defconfig
```kconfig
if SHIELD_CHOLIBRI_RIGHT

config ZMK_KEYBOARD_NAME
    default "Cholibri"

config ZMK_SPLIT_ROLE_CENTRAL
    default y

endif

if SHIELD_CHOLIBRI_LEFT || SHIELD_CHOLIBRI_RIGHT

config ZMK_SPLIT
    default y

endif

config I2C
    default y

if ZMK_BACKLIGHT

config PWM
    default y

config LED_PWM
    default y

endif # ZMK_BACKLIGHT
```

## config/boards/shields/verdin/Kconfig.defconfig
```kconfig
if SHIELD_VERDIN_RIGHT

config ZMK_KEYBOARD_NAME
    default "Verdin"

config ZMK_SPLIT_ROLE_CENTRAL
    default y

endif

if SHIELD_VERDIN_LEFT || SHIELD_VERDIN_RIGHT

config ZMK_SPLIT
    default y

config ZMK_RGB_UNDERGLOW
    select WS2812_STRIP
    select SPI

config I2C
    default y

endif
```

## config/boards/shields/verdin/Kconfig.shield
```kconfig
config SHIELD_VERDIN_LEFT
    def_bool $(shields_list_contains,verdin_left)

config SHIELD_VERDIN_RIGHT
    def_bool $(shields_list_contains,verdin_right)
```
